main:

LDI R16, 0xFF
OUT DDRD, R16

RJMP nine
L1 : RJMP eight
L2 : RJMP seven
L3 : RJMP six
L4 : RJMP five
L5 : RJMP four
L6 : RJMP three
L7 : RJMP two
L8 : RJMP one

nine:
LDI R16, 0X09
OUT PORTD, R16
NOP
CLR R16
RJMP L1

eight:
LDI R16, 0X08
OUT PORTD, R16
NOP
CLR R16
RJMP L2

seven:
LDI R16, 0X07
OUT PORTD, R16
NOP
CLR R16
RJMP L3

six:
LDI R16, 0X06
OUT PORTD, R16
NOP
CLR R16
RJMP L4

five:
LDI R16, 0X05
OUT PORTD, R16
NOP
CLR R16
RJMP L5

four:
LDI R16, 0X04
OUT PORTD, R16
NOP
CLR R16
RJMP L6

three:
LDI R16, 0X03
OUT PORTD, R16
NOP
CLR R16
RJMP L7

two:
LDI R16, 0X02
OUT PORTD, R16
NOP
CLR R16
RJMP L8

one:
LDI R16, 0X01
OUT PORTD, R16
NOP
CLR R16
RJMP main





